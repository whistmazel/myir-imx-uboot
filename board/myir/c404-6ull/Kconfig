## board/myir/c404-6ull/Kconfig
```kconfig
if TARGET_C404_6ULL

config SYS_BOARD
	default "c404-6ull"

config SYS_VENDOR
	default "myir"

config SYS_CONFIG_NAME
	default "c404-6ull"

config SYS_TEXT_BASE
	default 0x87800000
endif
```
